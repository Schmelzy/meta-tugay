## conf/distro/poky-tugay.conf
```bitbake
require conf/distro/poky.conf

DISTRO = "poky-tugay"

DISTRO_FEATURES:append = " systemd pam"
DISTRO_FEATURES:remove = "sysvinit"

# Use systemd as init manager
INIT_MANAGER = "systemd"
```
